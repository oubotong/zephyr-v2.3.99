## CMakeLists.txt
```
# SPDX-License-Identifier: Apache-2.0

cmake_minimum_required(VERSION 3.13.1)
find_package(Zephyr REQUIRED HINTS $ENV{ZEPHYR_BASE})
project(blinky)
#target_sources(app PRIVATE src/main.c src/mqtt-sn/mqttsn_client.c src/mqtt-sn/mqttsn_gateway_discovery.c src/mqtt-sn/mqttsn_gateway_discovery.c src/mqtt-sn/mqttsn_packet_fifo.c src/mqtt-sn/mqttsn_packet_receiver.c src/mqtt-sn/mqttsn_packet_receiver.c src/mqtt-sn/mqttsn_packet_sender.c src/mqtt-sn/mqttsn_platform.c src/mqtt-sn/mqttsn_transport_ot.c src/mqtt-sn/MQTTSNPacket.c src/mqtt-sn/MQTTSNConnectClient.c src/mqtt-sn/MQTTSNConnectServer.c src/mqtt-sn/MQTTSNDeserializePublish.c src/mqtt-sn/MQTTSNSearchClient.c src/mqtt-sn/MQTTSNSearchServer.c src/mqtt-sn/MQTTSNSerializePublish.c src/mqtt-sn/MQTTSNSubscribeClient.c src/mqtt-sn/MQTTSNSubscribeServer.c src/mqtt-sn/MQTTSNUnsubscribeClient.c src/mqtt-sn/MQTTSNUnsubscribeServer.c)
#SET(CMAKE_C_FLAGS  -DUART_AS_SERIAL_TRANSPORT=1)
set(COMMON_INCLUDES
    ${OT_PUBLIC_INCLUDES}
    #/home/dafran/zephyrproject/modules/lib/openthread/examples/platforms
    #/home/dafran/zephyrproject/modules/lib/openthread/src/core
    #/home/dafran/zephyrproject/modules/lib/openthread/src/cli
)
target_sources(app PRIVATE src/main.c ) 
#set_target_properties(app PROPERTIES LINK_DEPENDS /home/dafran/zephyrproject/modules/lib/openthread/examples/platforms/nrf528xx/nrf52840/nrf52840.ld/nrf52840_bootloader_uart.ld)
target_include_directories(app PRIVATE ${COMMON_INCLUDES})
```

## prj.conf
```kconfig
# Generic networking options
CONFIG_NETWORKING=y
CONFIG_NET_UDP=y
CONFIG_NET_TCP=y
CONFIG_NET_IPV6=y
CONFIG_NET_IPV4=y
CONFIG_NET_SOCKETS=y
CONFIG_NET_SOCKETS_POSIX_NAMES=y
CONFIG_NET_SOCKETS_POLL_MAX=4
CONFIG_NET_CONNECTION_MANAGER=y

# Kernel options
CONFIG_MAIN_STACK_SIZE=2048
CONFIG_ENTROPY_GENERATOR=y
CONFIG_TEST_RANDOM_GENERATOR=y
CONFIG_INIT_STACKS=y

# Logging
CONFIG_NET_LOG=y
CONFIG_LOG=y
CONFIG_NET_STATISTICS=y
CONFIG_PRINTK=y

# Network buffers
CONFIG_NET_PKT_RX_COUNT=16
CONFIG_NET_PKT_TX_COUNT=16
CONFIG_NET_BUF_RX_COUNT=80
CONFIG_NET_BUF_TX_COUNT=80
CONFIG_NET_CONTEXT_NET_PKT_POOL=y

# IP address options
CONFIG_NET_IF_UNICAST_IPV6_ADDR_COUNT=3
CONFIG_NET_IF_MCAST_IPV6_ADDR_COUNT=4
CONFIG_NET_MAX_CONTEXTS=10

# Network shell
CONFIG_NET_SHELL=y

# The addresses are selected so that qemu<->qemu connectivity works ok.
# For linux<->qemu connectivity, create a new conf file and swap the
# addresses (so that peer address is ending to 2).
#CONFIG_NET_CONFIG_SETTINGS=y
#CONFIG_NET_CONFIG_NEED_IPV6=y
#CONFIG_NET_CONFIG_MY_IPV6_ADDR="2001:db8::2"
#CONFIG_NET_CONFIG_PEER_IPV6_ADDR="2001:db8::1"
#CONFIG_NET_CONFIG_NEED_IPV4=y
#CONFIG_NET_CONFIG_MY_IPV4_ADDR="192.0.2.2"
#CONFIG_NET_CONFIG_PEER_IPV4_ADDR="192.0.2.1"
```

## overlay-ot.conf
```kconfig
CONFIG_NEWLIB_LIBC=y

# Disable TCP and IPv4 (TCP disabled to avoid heavy traffic)
CONFIG_OPENTHREAD_COAP=y
CONFIG_NET_TCP=n
CONFIG_NET_IPV4=n

CONFIG_NET_IPV6_NBR_CACHE=n
CONFIG_NET_IPV6_MLD=n
CONFIG_NET_CONFIG_NEED_IPV4=n
CONFIG_NET_CONFIG_MY_IPV4_ADDR=""
CONFIG_NET_CONFIG_PEER_IPV4_ADDR=""

CONFIG_SYSTEM_WORKQUEUE_STACK_SIZE=2048
CONFIG_SHELL_STACK_SIZE=3072

CONFIG_NET_L2_OPENTHREAD=y

CONFIG_OPENTHREAD_DEBUG=y
CONFIG_OPENTHREAD_L2_DEBUG=y
CONFIG_OPENTHREAD_L2_LOG_LEVEL_INF=y

CONFIG_OPENTHREAD_CHANNEL=25

CONFIG_NET_CONFIG_MY_IPV6_ADDR="fdde:ad00:beef::1"
CONFIG_NET_CONFIG_PEER_IPV6_ADDR="fdde:ad00:beef::2"

# mbedTLS tweaks
CONFIG_MBEDTLS_SSL_MAX_CONTENT_LEN=768

# A sample configuration to enable Thread Joiner, uncomment if needed
#CONFIG_OPENTHREAD_JOINER=y
#CONFIG_OPENTHREAD_JOINER_AUTOSTART=y

# Enable diagnostic module, uncomment if needed
#CONFIG_OPENTHREAD_DIAG=y
```

## src/main.c
```c
/*
 *  Copyright (c) 2018, Vit Holasek
 *  All rights reserved.
 *
 *  Redistribution and use in source and binary forms, with or without
 *  modification, are permitted provided that the following conditions are met:
 *  1. Redistributions of source code must retain the above copyright
 *     notice, this list of conditions and the following disclaimer.
 *  2. Redistributions in binary form must reproduce the above copyright
 *     notice, this list of conditions and the following disclaimer in the
 *     documentation and/or other materials provided with the distribution.
 *  3. Neither the name of the copyright holder nor the
 *     names of its contributors may be used to endorse or promote products
 *     derived from this software without specific prior written permission.
 *
 *  THIS SOFTWARE IS PROVIDED BY THE COPYRIGHT HOLDERS AND CONTRIBUTORS "AS IS"
 *  AND ANY EXPRESS OR IMPLIED WARRANTIES, INCLUDING, BUT NOT LIMITED TO, THE
 *  IMPLIED WARRANTIES OF MERCHANTABILITY AND FITNESS FOR A PARTICULAR PURPOSE
 *  ARE DISCLAIMED. IN NO EVENT SHALL THE COPYRIGHT HOLDER OR CONTRIBUTORS BE
 *  LIABLE FOR ANY DIRECT, INDIRECT, INCIDENTAL, SPECIAL, EXEMPLARY, OR
 *  CONSEQUENTIAL DAMAGES (INCLUDING, BUT NOT LIMITED TO, PROCUREMENT OF
 *  SUBSTITUTE GOODS OR SERVICES; LOSS OF USE, DATA, OR PROFITS; OR BUSINESS
 *  INTERRUPTION) HOWEVER CAUSED AND ON ANY THEORY OF LIABILITY, WHETHER IN
 *  CONTRACT, STRICT LIABILITY, OR TORT (INCLUDING NEGLIGENCE OR OTHERWISE)
 *  ARISING IN ANY WAY OUT OF THE USE OF THIS SOFTWARE, EVEN IF ADVISED OF THE
 *  POSSIBILITY OF SUCH DAMAGE.
 */

#include <string.h>
#include <unistd.h>
#include <stdlib.h>
#include <stdio.h>
#include <stdbool.h>
#include <zephyr.h>
//#include <device.h>
//#include <devicetree.h>
//#include <drivers/gpio.h>

#include "openthread/cli.h"
#include "openthread/instance.h"
#include "openthread/thread.h"
#include "openthread/tasklet.h"
#include "openthread/ip6.h"
#include "openthread/dataset.h"
#include "openthread/link.h"
//#include "openthread-system.h"

#define NETWORK_NAME "OpenThread"
#define PANID 0xFACE
//#define EXTPANID {0x33, 0x33, 0x33, 0x33, 0x44, 0x44, 0x44, 0x44}
#define DEFAULT_CHANNEL 25
//#define MASTER_KEY {0x33, 0x33, 0x44, 0x44, 0x33, 0x33, 0x44, 0x44, 0x33, 0x33, 0x44, 0x44, 0x33, 0x33, 0x44, 0x44}

#define GATEWAY_PORT 47193
#define GATEWAY_ADDRESS "fd11:22::1637:7871:d626:bf3e"

#define GATEWAY_MULTICAST_PORT 47193
#define GATEWAY_MULTICAST_ADDRESS "ff02::1"
#define GATEWAY_MULTICAST_RADIUS 8

#define CLIENT_ID "NRF52840"
#define CLIENT_PORT 47193


//static const uint8_t sExpanId[] = EXTPANID;
//static const uint8_t sMasterKey[] = MASTER_KEY;

/*static void SearchGateway(otInstance *instance);
static void HandleSearchGw(const otIp6Address* aAddress, uint8_t aGatewayId, void* aContext);*/

static void HandleConnected(otMqttsnReturnCode aCode, void* aContext)
{
    OT_UNUSED_VARIABLE(aCode);
    OT_UNUSED_VARIABLE(aContext);
    printf("Connected\n");
    otInstance *instance = (otInstance *)aContext;
    const char *clientStateString;
    otMqttsnClientStateToString(otMqttsnGetState(instance), &clientStateString);
    printf("MQTT state:%s\n",clientStateString);
    // Handle connected
}

static void HandleDisconnected(otMqttsnDisconnectType aType, void* aContext)
{
    OT_UNUSED_VARIABLE(aType);
    OT_UNUSED_VARIABLE(aContext);
    printf("Disconnected\n");
    // Handle disconnect
}

/*static void MqttsnConnect(otInstance *instance)
{
    otIp6Address address;
    otIp6AddressFromString(GATEWAY_ADDRESS, &address);

    // Set MQTT-SN client configuration settings
    otMqttsnConfig config;
    config.mClientId = CLIENT_ID;
    config.mKeepAlive = 30;
    config.mCleanSession = true;
    config.mPort = GATEWAY_PORT;
    config.mAddress = &address;
    config.mRetransmissionCount = 3;
    config.mRetransmissionTimeout = 10;

    // Register connected callback
    otMqttsnSetConnectedHandler(instance, HandleConnected, (void *)instance);
    // Register disconnected callback
    otMqttsnSetDisconnectedHandler(instance, HandleDisconnected, (void *)instance);
    // Connect to the MQTT broker (gateway)
    otMqttsnConnect(instance, &config);
}*/

inline uint16_t Swap16(uint16_t v)
{
    return (((v & 0x00ffU) << 8) & 0xff00) | (((v & 0xff00U) >> 8) & 0x00ff);
}


static void StateChanged(otChangedFlags aFlags, void *aContext)
{
    otInstance *instance = (otInstance *)aContext;
    if ((aFlags & OT_CHANGED_THREAD_ROLE) != 0)
   {
       otDeviceRole changedRole = otThreadGetDeviceRole(aContext);

       switch (changedRole)
       {
       case OT_DEVICE_ROLE_LEADER:
           printf("Leader\n");
           break;

       case OT_DEVICE_ROLE_ROUTER:
           {
           printf("Router\n");
           printf("Router search gateway\n");
           const otNetifAddress *unicastAddrs = otIp6GetUnicastAddresses(instance);

   	 for (const otNetifAddress *addr = unicastAddrs; addr; addr = addr->mNext)
   	 {
         	 otIp6Address address = addr->mAddress;
         	 printf("End device:%x:%x:%x:%x:%x:%x:%x:%x\n", Swap16(address.mFields.m16[0]), 	Swap16(address.mFields.m16[1]),
	         Swap16(address.mFields.m16[2]), Swap16(address.mFields.m16[3]), 			    Swap16(address.mFields.m16[4]),
                 Swap16(address.mFields.m16[5]), Swap16(address.mFields.m16[6]), 				Swap16(address.mFields.m16[7]));
         }
         if(otMqttsnGetState(instance) == kStateDisconnected){
            printf("begin to connect\n");
            otIp6Address address;
            uint16_t port=47193;
            otIp6AddressFromString(GATEWAY_ADDRESS, &address);
            otMqttsnSetConnectedHandler(instance, HandleConnected, (void *)instance);
            otMqttsnSetDisconnectedHandler(instance, HandleDisconnected, (void *)instance);
            otMqttsnConnectDefault(instance,&address,(uint16_t)port);
            //MqttsnConnect(instance);
	 }  
           //SearchGateway(instance); 
           }
           break;
       
       case OT_DEVICE_ROLE_CHILD:
           {
           printf("Child\n");
           printf("Child search gateway\n");
          const otNetifAddress *unicastAddrs = otIp6GetUnicastAddresses(instance);

   	 for (const otNetifAddress *addr = unicastAddrs; addr; addr = addr->mNext)
   	 {
         	 otIp6Address address = addr->mAddress;
         	 printf("End device:%x:%x:%x:%x:%x:%x:%x:%x\n", Swap16(address.mFields.m16[0]), 	Swap16(address.mFields.m16[1]),
	         Swap16(address.mFields.m16[2]), Swap16(address.mFields.m16[3]), 			    Swap16(address.mFields.m16[4]),
                 Swap16(address.mFields.m16[5]), Swap16(address.mFields.m16[6]), 				Swap16(address.mFields.m16[7]));
         }
           //SearchGateway(instance);
           }
           break;
       
       case OT_DEVICE_ROLE_DETACHED:
           printf("Detached\n");
	   break;
       case OT_DEVICE_ROLE_DISABLED:
           /* Clear LED4 if Thread is not enabled. */
           printf("Disable\n");
           break;
        }
    }
    /*if (aFlags & OT_CHANGED_THREAD_ROLE)
    {
        otDeviceRole role = otThreadGetDeviceRole(instance);
        // If role changed to any of active roles then send SEARCHGW message
        if (role == OT_DEVICE_ROLE_CHILD || role == OT_DEVICE_ROLE_ROUTER)
        {
            printf("search gateway\n");
            SearchGateway(instance);
        }
    }*/
    // when thread role changed
   /* if (aFlags & OT_CHANGED_THREAD_ROLE)
    {
        otDeviceRole role = otThreadGetDeviceRole(instance);
        // If role changed to any of active roles and MQTT-SN client is not connected then connect
        if ((role == OT_DEVICE_ROLE_CHILD || role == OT_DEVICE_ROLE_ROUTER)
            && otMqttsnGetState(instance) == kStateDisconnected)
        {
            MqttsnConnect(instance);
        }
    }*/
}


/*static void HandleSearchGw(const otIp6Address* aAddress, uint8_t aGatewayId, void* aContext)
{
    printf("call into handler\n");
    OT_UNUSED_VARIABLE(aGatewayId);
    // Handle SEARCHGW response received
    // Connect to received address
    otInstance *instance = (otInstance *)aContext;
    otIp6Address address = *aAddress;
    printf("address:%x:%x:%x:%x:%x:%x:%x:%x", address.mFields.m16[0], address.mFields.m16[1],
address.mFields.m16[2], address.mFields.m16[3], address.mFields.m16[4],
        address.mFields.m16[5], address.mFields.m16[6], address.mFields.m16[7]);
    // Set MQTT-SN client configuration settings
    otMqttsnConfig config;
    config.mClientId = CLIENT_ID;
    config.mKeepAlive = 30;
    config.mCleanSession = true;
    config.mPort = GATEWAY_MULTICAST_PORT;
    config.mAddress = &address;
    config.mRetransmissionCount = 3;
    config.mRetransmissionTimeout = 5;

    // Register connected callback
    otMqttsnSetConnectedHandler(instance, HandleConnected, (void *)instance);
    // Connect to the MQTT broker (gateway)+
    otMqttsnConnect(instance, &config);

}

static void SearchGateway(otInstance *instance)
{
    otIp6Address address;
    otIp6AddressFromString(GATEWAY_MULTICAST_ADDRESS, &address);

    otMqttsnSetSearchgwHandler(instance, HandleSearchGw, (void *)instance);
    // Send SEARCHGW multicast message
    otMqttsnSearchGateway(instance, &address, GATEWAY_MULTICAST_PORT, GATEWAY_MULTICAST_RADIUS);
}*/

int main(int aArgc, char *aArgv[])
{
    otError error = OT_ERROR_NONE;
    //otExtendedPanId extendedPanid;
    //otMasterKey masterKey;
    otInstance *instance;

    otSysInit(aArgc, aArgv);
    instance = otInstanceInitSingle();

    // Set default network settings
    // Set network name
    error = otThreadSetNetworkName(instance, NETWORK_NAME);
    // Set extended PANID
    //memcpy(extendedPanid.m8, sExpanId, sizeof(sExpanId));
   // error = otThreadSetExtendedPanId(instance, &extendedPanid);
    // Set PANID
    error = otLinkSetPanId(instance, PANID);
    // Set channel
    error = otLinkSetChannel(instance, DEFAULT_CHANNEL);
    // Set masterkey
    //memcpy(masterKey.m8, sMasterKey, sizeof(sMasterKey));
    //error = otThreadSetMasterKey(instance, &masterKey);

    // Register notifier callback to receive thread role changed events
    error = otSetStateChangedCallback(instance, StateChanged, instance);

    // Start thread network
    //otIp6SetSlaacEnabled(instance, true);
    error = otIp6SetEnabled(instance, true);
    error = otThreadSetEnabled(instance, true);
    error = otMqttsnStart(instance, CLIENT_PORT);
    //otCliUartInit(instance);

    while (true)
    {
        otTaskletsProcess(instance);
        otSysProcessDrivers(instance);
    }
    return error;
}
```

## src/main_old.c
```c
/*
 * Copyright (c) 2016 Intel Corporation
 *
 * SPDX-License-Identifier: Apache-2.0
 */
#include "mqtt-sn/mqttsn_client.h"
#include <zephyr.h>
#include <stdio.h>
#include <device.h>
#include <devicetree.h>
#include <drivers/gpio.h>
#include <string.h>


#include <openthread/config.h>
#include <openthread/dataset_ftd.h>
#include <openthread/cli.h>
#include <openthread/diag.h>
#include <openthread/tasklet.h>
#include <openthread/instance.h>
#include <openthread/thread.h>
#include <openthread/thread_ftd.h>
#include <openthread/cli_config.h>

static void mqttsn_init(otInstance *aInstance);
void mqttsn_evt_handler(mqttsn_client_t * p_client, mqttsn_event_t * p_event);
static void gateway_info_callback(mqttsn_event_t * p_event);
static void connected_callback(void);
static void disconnected_callback(void);
static void regack_callback(mqttsn_event_t * p_event);
static void received_callback(mqttsn_event_t * p_event);
static void timeout_callback(mqttsn_event_t * p_event);
static void searchgw_timeout_callback(mqttsn_event_t * p_event);
static void subscribe();
static void connect_opt_init(void);
//static void publish(void);

static void setNetworkConfiguration(otInstance *aInstance);
void handleNetifStateChanged(uint32_t aFlags, void *aContext);
#ifndef OPENTHREAD_ENABLE_COVERAGE
#define OPENTHREAD_ENABLE_COVERAGE 0
#endif

#define SEARCH_GATEWAY_TIMEOUT 5                                            /**< MQTT-SN Gateway discovery procedure timeout in [s]. */

#define SCHED_QUEUE_SIZE       32                                           /**< Maximum number of events in the scheduler queue. */
#define SCHED_EVENT_DATA_SIZE  APP_TIMER_SCHED_EVENT_DATA_SIZE              /**< Maximum app_scheduler event size. */

static mqttsn_client_t      m_client;                                       /**< An MQTT-SN client instance. */
static mqttsn_remote_t      m_gateway_addr;                                 /**< A gateway address. */
static uint8_t              m_gateway_id;                                   /**< A gateway ID. */
static mqttsn_connect_opt_t m_connect_opt;                                  /**< Connect options for the MQTT-SN client. */
//static uint8_t              m_led_state        = 0;                         /**< Previously sent BSP_LED_2 command. */
static uint16_t             m_msg_id           = 0;                         /**< Message ID thrown with MQTTSN_EVENT_TIMEOUT. */
static char                 m_client_id[]      = "nRF52840";      /**< The MQTT-SN Client's ID. */
static char                 m_topic_name_pub[]     = "nRF52840/data"; /**< Name of the topic corresponding to subscriber's BSP_LED_2. */
static mqttsn_topic_t       m_topic_pub            =                            /**< Topic corresponding to subscriber's BSP_LED_2. */
{
    .p_topic_name = (unsigned char *)m_topic_name_pub,
    .topic_id     = 0,
};

/////////////////////////////////////////////////////
static char                 m_topic_name_sub[]     = "nRF52840/cmd"; /**< Name of the topic corresponding to subscriber's BSP_LED_2. */
static mqttsn_topic_t       m_topic_sub            =                            /**< Topic corresponding to subscriber's BSP_LED_2. */
{
    .p_topic_name = (unsigned char *)m_topic_name_sub,
    .topic_id     = 0,
};

static bool g_sub_registered = false;
static bool g_led_2_on = false;

int main(int argc, char *argv[])
{
    otSysInit(argc, argv);
    otInstance *instance;

    printf("begin to connect!!\n");


    instance = otInstanceInitSingle();
    printf("single instance!!\n");


    otSetStateChangedCallback(instance, handleNetifStateChanged, instance);
    
    setNetworkConfiguration(instance);

    otIp6SetEnabled(instance, true);
    printf("ifconfig up!!\n");

    otThreadSetEnabled(instance, true);

    printf("thread start!!\n");

    mqttsn_init(instance);
   
    while (1)
    {
        otTaskletsProcess(instance);
        otSysProcessDrivers(instance);
    }

    otInstanceFinalize(instance);


    return 0;
}

void handleNetifStateChanged(uint32_t aFlags, void *aContext)
{
   if ((aFlags & OT_CHANGED_THREAD_ROLE) != 0)
   {
       otDeviceRole changedRole = otThreadGetDeviceRole(aContext);

       switch (changedRole)
       {
       case OT_DEVICE_ROLE_LEADER:
           printf("Leader\n");
           break;

       case OT_DEVICE_ROLE_ROUTER:
           printf("Router\n");
           break;
       
       case OT_DEVICE_ROLE_CHILD:
           printf("Child\n");
           break;
       
       case OT_DEVICE_ROLE_DETACHED:
           printf("Detached\n");
	   break;
       case OT_DEVICE_ROLE_DISABLED:
           /* Clear LED4 if Thread is not enabled. */
           printf("Disable\n");
           break;
        }
    }

}

/**
 * Override default network settings, such as panid, so the devices can join a network
 */
void setNetworkConfiguration(otInstance *aInstance)
{
    static char          aNetworkName[] = "OpenThread";
    otOperationalDataset aDataset;

    memset(&aDataset, 0, sizeof(otOperationalDataset));
   
    /*
     * Fields that can be configured in otOperationDataset to override defaults:
     *     Network Name, Mesh Local Prefix, Extended PAN ID, PAN ID, Delay Timer,
     *     Channel, Channel Mask Page 0, Network Master Key, PSKc, Security Policy
     */
    aDataset.mActiveTimestamp                      = 1;
    aDataset.mComponents.mIsActiveTimestampPresent = true;
     
    /* Set Channel to 15 */
    aDataset.mChannel                      = 25;
    aDataset.mComponents.mIsChannelPresent = true;
    
    /* Set Pan ID to 2222 */
    aDataset.mPanId                      = (otPanId)0xFACE;
    aDataset.mComponents.mIsPanIdPresent = true;

    /* Set Extended Pan ID to C0DE1AB5C0DE1AB5 */
    //uint8_t extPanId[OT_EXT_PAN_ID_SIZE] = {0xDE, 0xAD, 0x00, 0xBE, 0xEF, 0x00, 0xCA, 0xFE};
    //memcpy(aDataset.mExtendedPanId.m8, extPanId, sizeof(aDataset.mExtendedPanId));
    //aDataset.mComponents.mIsExtendedPanIdPresent = true;
    
    /* Set master key to 1234C0DE1AB51234C0DE1AB51234C0DE */
    //uint8_t key[OT_MASTER_KEY_SIZE] = {0x00, 0x11, 0x22, 0x33, 0x44, 0x55, 0x66, 0x77, 0x88, 0x99, 0xAA, 0xBB, 0xCC, 0xDD, 0xEE, 0xFF};
    //memcpy(aDataset.mMasterKey.m8, key, sizeof(aDataset.mMasterKey));
    //aDataset.mComponents.mIsMasterKeyPresent = true;

    /* Set Network Name to OTCodelab */
    size_t length = strlen(aNetworkName);
    memcpy(aDataset.mNetworkName.m8, aNetworkName, length);
    aDataset.mComponents.mIsNetworkNamePresent = true;

    otDatasetSetActive(aInstance, &aDataset);

    /*otLinkModeConfig mode;
    memset(&mode, 0, sizeof(mode));
    mode.mRxOnWhenIdle       = true; 
    mode.mSecureDataRequests = false;
    mode.mDeviceType         = true;
    mode.mNetworkData        = true;


    otThreadSetLinkMode(aInstance, mode);*/
    
    
    /* Set the router selection jitter to override the 2 minute default.
       CLI cmd > routerselectionjitter 20
       Warning: For demo purposes only - not to be used in a real product */
    // jitterValue = 20;
    //otThreadSetRouterSelectionJitter(aInstance, jitterValue);

}

static void mqttsn_init(otInstance *aInstance)
{
    printf("MQTT-SN initing\n");
    uint32_t error_code=mqttsn_client_init(&m_client,
                                           MQTTSN_DEFAULT_CLIENT_PORT,
                                           mqttsn_evt_handler,
                                           aInstance);

    connect_opt_init();
}

void mqttsn_evt_handler(mqttsn_client_t * p_client, mqttsn_event_t * p_event)
{
    switch(p_event->event_id)
    {
        case MQTTSN_EVENT_GATEWAY_FOUND:
	    printf("Getting gateway info\n");
            gateway_info_callback(p_event);
            break;

        case MQTTSN_EVENT_CONNECTED:
            printf("Getting connected\n");
            connected_callback();
            break;

        case MQTTSN_EVENT_DISCONNECT_PERMIT:
            printf("Getting disconnected\n");
            disconnected_callback();
            break;

        case MQTTSN_EVENT_REGISTERED:
            printf("Registering event\n");
            regack_callback(p_event);
            break;

        case MQTTSN_EVENT_PUBLISHED:
            break;

	case MQTTSN_EVENT_SUBSCRIBED:
            break;

	case MQTTSN_EVENT_UNSUBSCRIBED:
            break;

        case MQTTSN_EVENT_RECEIVED:
            printf("Receiving event\n");
            received_callback(p_event);
            break;

        case MQTTSN_EVENT_TIMEOUT:
	    printf("Event Timing out\n");
            timeout_callback(p_event);
            break;

        case MQTTSN_EVENT_SEARCHGW_TIMEOUT:
            printf("Searching gateway timing out\n");
            searchgw_timeout_callback(p_event);
            break;

        default:
            break;
    }
}
static void gateway_info_callback(mqttsn_event_t * p_event)
{
    m_gateway_addr = *(p_event->event_data.connected.p_gateway_addr);
    m_gateway_id   = p_event->event_data.connected.gateway_id;
}
static void connected_callback(void)
{
    printf("Connected to Broker\n");

    uint32_t error_code=mqttsn_client_topic_register(&m_client,
                                                     m_topic_pub.p_topic_name,
                                                     strlen(m_topic_name_pub),
                                                     &m_msg_id);
}
static void disconnected_callback(void)
{
    printf("Disconnected to Broker\n");
}
static void regack_callback(mqttsn_event_t * p_event)
{
    printf("MQTT-SN event: Topic has been registered with ID: %d.\r\n",
                 p_event->event_data.registered.packet.topic.topic_id);
    
    if (!g_sub_registered)
    {   
        m_topic_pub.topic_id = p_event->event_data.registered.packet.topic.topic_id;

        g_sub_registered = true;

        uint32_t error_code=mqttsn_client_topic_register(&m_client,
                                                     m_topic_sub.p_topic_name,
                                                     strlen(m_topic_name_sub),
                                                     &m_msg_id);

    }
    else 
    {
        // store id
        m_topic_sub.topic_id = p_event->event_data.registered.packet.topic.topic_id;
        // subscribe
        subscribe();
    }

}
static void received_callback(mqttsn_event_t * p_event)
{
    if (p_event->event_data.published.packet.topic.topic_id == m_topic_sub.topic_id)
    {
        uint8_t* p_data = p_event->event_data.published.p_payload;


        // turn LEDs on/off
        if (p_data[0] == '1') {
            //LEDS_ON(BSP_LED_2_MASK);
            printf("LED 1 ON\n");
            g_led_2_on = true;
        }
        else {
            //LEDS_OFF(BSP_LED_2_MASK);
            printf("LED 1 OFF\n");
            g_led_2_on = false;
        }
    }
    else
    {
        printf("MQTT-SN event: Content to unsubscribed topic received. Dropping packet.\r\n");
    }
}
static void timeout_callback(mqttsn_event_t * p_event)
{
    printf("Time out\n");
}
static void searchgw_timeout_callback(mqttsn_event_t * p_event)
{
    printf("MQTT-SN event: Gateway discovery result: 0x%x.\r\n", p_event->event_data.discovery);
    if (p_event->event_data.discovery == 0)
    {
        //LEDS_ON(BSP_LED_2_MASK);
        printf("LED 1 ON\n");
        g_led_2_on = true;
    }
}
static void subscribe()
{
    uint8_t  topic_name_len = strlen(m_topic_name_sub);
    uint32_t error_code=mqttsn_client_subscribe(&m_client, 
        m_topic_sub.p_topic_name, topic_name_len, &m_msg_id);
    printf("Subscribed\n");
}
static void connect_opt_init(void)
{
    m_connect_opt.alive_duration = MQTTSN_DEFAULT_ALIVE_DURATION,
    m_connect_opt.clean_session  = MQTTSN_DEFAULT_CLEAN_SESSION_FLAG,
    m_connect_opt.will_flag      = MQTTSN_DEFAULT_WILL_FLAG,
    m_connect_opt.client_id_len  = strlen(m_client_id),

    memcpy(m_connect_opt.p_client_id, (unsigned char *)m_client_id, m_connect_opt.client_id_len);
}
/*static void publish(void)
{
    char* pub_data = "hello";
    uint32_t err_code = mqttsn_client_publish(&m_client, m_topic_pub.topic_id, 
        (uint8_t*)pub_data, strlen(pub_data), &m_msg_id);
}*/
```
